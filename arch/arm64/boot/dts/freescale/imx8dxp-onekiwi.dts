// SPDX-License-Identifier: GPL-2.0+
/*
 * Copyright 2019 NXP
 */

/dts-v1/;

#include "imx8dxp.dtsi"
#include "imx8dxp-onekiwi.dtsi"

/ {
	model = "OneKiwi i.MX8DXP SOM";
	compatible = "onekiwi,imx8dxp-onekiwi", "fsl,imx8dxp", "fsl,imx8qxp";
};

&usbotg3 {
	dr_mode = "otg";
	extcon = <&typec_ptn5150>;
	status = "okay";
};
