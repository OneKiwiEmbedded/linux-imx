// SPDX-License-Identifier: GPL-2.0+
/*
 * Copyright 2019-2023 Variscite Ltd.
 */

#include "imx8qxp-var-som-wifi.dts"
#include "imx8qxp-var-som-m4.dtsi"

/ {
	model = "Variscite VAR-SOM-MX8X on Symphony-Board WIFI M4";
};
